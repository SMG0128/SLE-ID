## card_ws63/platform/ws63/Kconfig
```kconfig
config SLE_CARD_NV_SLOT_A_KEY
    hex "Credential store NV slot A key (Card namespace 0x5C00-0x5CFF)"
    default 0x5C10

config SLE_CARD_NV_SLOT_B_KEY
    hex "Credential store NV slot B key (Card namespace 0x5C00-0x5CFF)"
    default 0x5C11
```

## firmware/h3863/sle_ab/Kconfig
```kconfig
choice
    prompt "Select SLE A/B detector role"
    default SLE_AB_ROLE_A

config SLE_AB_ROLE_A
    bool "Detector A - passage sensing and SLE client"

config SLE_AB_ROLE_B
    bool "Detector B - policy, gateway and SLE server"
endchoice

config SLE_AB_UART_BUS
    int "Console UART bus"
    default 0

config SLE_AB_UART_TX_PIN
    int "Console UART TX pin"
    default 17

config SLE_AB_UART_RX_PIN
    int "Console UART RX pin"
    default 18

config SLE_AB_ACTUATOR_PIN
    int "Detector B actuator/LED GPIO"
    default 10

config SLE_AB_TEST_MODE
    bool "Enable serial demo and simulated authentication commands"
    default y
    help
        Development only. Disable this for a production build so that serial
        commands cannot forge passage observations or authentication results.

config SLE_UART_MSGQ_ITEM_SIZE
    int
    default 520

config SLE_UART_MTU_SIZE
    int
    default 520

config SLE_UART_CONN_INTERVAL
    int "SLE connection interval (x1.25ms)"
    default 12
    range 6 32

config SUPPORT_SLE_CENTRAL
    bool
    default y if SLE_AB_ROLE_A

config SUPPORT_SLE_PERIPHERAL
    bool
    default y if SLE_AB_ROLE_B
```

## firmware/h3863/sle_card/Kconfig
```kconfig
config SLE_CARD_ID
    hex "Stable anonymous Card ID"
    default 0xC0000001

config SLE_CARD_FIRMWARE_VERSION
    hex "Card firmware version"
    default 0x00010100

choice
    prompt "Card credential storage backend"
    default SLE_CARD_STORE_RAM

config SLE_CARD_STORE_RAM
    bool "Volatile RAM store (safe bring-up)"
    help
        Uses RAM only. Credentials and usage counters are lost after reset.

config SLE_CARD_STORE_NV
    bool "Persistent WS63 NV double-slot store"
endchoice

config SLE_CARD_NV_SLOT_A_KEY
    hex "Credential NV slot A key (Card namespace 0x5C00-0x5CFF)"
    default 0x5C10
    depends on SLE_CARD_STORE_NV
    help
        The project reserves 0x5C00-0x5CFF for Card C. The default slot A key
        is 0x5C10 and must differ from slot B.

config SLE_CARD_NV_SLOT_B_KEY
    hex "Credential NV slot B key (Card namespace 0x5C00-0x5CFF)"
    default 0x5C11
    depends on SLE_CARD_STORE_NV
    help
        The project reserves 0x5C00-0x5CFF for Card C. The default slot B key
        is 0x5C11 and must differ from slot A.

config SLE_CARD_MTU_SIZE
    int "Card SLE MTU"
    default 128
    range 96 520

config SLE_CARD_CONN_INTERVAL
    int "Card SLE connection interval (x1.25 ms)"
    default 12
    range 6 32

config SLE_CARD_UART_BUS
    int "Card maintenance UART bus"
    default 0

config SLE_CARD_UART_TX_PIN
    int "Card maintenance UART TX pin"
    default 17

config SLE_CARD_UART_RX_PIN
    int "Card maintenance UART RX pin"
    default 18

config SLE_CARD_SERIAL_PROVISIONING
    bool "Enable local serial provisioning protocol"
    default y if SLE_CARD_STORE_RAM
    default n
    help
        Enables the development-only `proto <hex-frame>` command on the local
        UART. Keep this disabled in a persistent/production Card image unless
        physical access to the maintenance UART is controlled.

config SUPPORT_SLE_PERIPHERAL
    bool
    default y
```
